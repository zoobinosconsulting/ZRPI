## meta-zoobinos/conf/layer.conf
```bitbake
# We have a conf and classes directory, add to BBPATH
BBPATH .= ":${LAYERDIR}"

# We have recipes-* directories, add to BBFILES
BBFILES += "${LAYERDIR}/recipes-*/*/*.bb \
	${LAYERDIR}/recipes-*/*/*.bbappend"

BBFILE_COLLECTIONS += "zoobinos"
BBFILE_PATTERN_zoobinos = "^${LAYERDIR}/"
BBFILE_PRIORITY_zoobinos = "6"
```
